## conf/layer.conf
```bitbake
# We have a conf directory, add to BBPATH
BBPATH .= ":${LAYERDIR}"

# We have recipe directories containing .bb and .bbappend files, add to BBFILES
BBFILES += "${LAYERDIR}/recipes-*/*/*.bb \
            ${LAYERDIR}/recipes-*/*/*.bbappend"

BBFILE_COLLECTIONS += "meta-orgconf"
BBFILE_PATTERN_meta-orgconf = "^${LAYERDIR}/"
BBFILE_PRIORITY_meta-orgconf = "15"

LAYERSERIES_COMPAT_meta-orgconf = "sumo"

BB_ENV_EXTRAWHITE += "SAFEMODE_PAYLOAD_PATH"
```
